// ═══════════════════════════════════════════════════════════
// Patternflow Ensemble - the hub
//
// Hardware: ESP32-S3-DevKitC-1, nothing attached.
// Role    : the Wi-Fi the panels are on, the conductor that links them, and
//           a console for a laptop (USB) or a phone (Wi-Fi).
//
//   panels ──UDP 7400, PFE/1──▶ conductor ──lines of JSON──▶ console
//                                   │                          USB serial (the "USB" jack)
//                                   │                          UART (the "COM" jack)
//                                   └── flash (NVS): setup     WebSocket /ws + the page at /
//
// Two more things answer over HTTP, for scripts: /api/status (the hub) and
// /api/panels (every panel's number, uid and address - what
// ../../tools/panels.py reads to put firmware on the panels or take it off).
//
// Everything that decides anything is ../../core/pfe_conductor.h, the same
// file the tests and the console's demo run. This file is the wiring:
// Wi-Fi, a UDP socket, three places a console can be, and flash.
//
// One rule shapes it: nothing a laptop does may hold up the panels. A
// serial port whose reader has stopped (a browser tab asleep) blocks its
// writer, so each port is written by a task of its own, fed through a
// buffer that drops lines when it is full. The lines are state, not events
// that must not be lost: the next one says the same and more.
//
// License: MIT
// ═══════════════════════════════════════════════════════════
#include <Arduino.h>
#include <ESPAsyncWebServer.h>
#include <ESPmDNS.h>
#include <Preferences.h>
#include <USB.h>
#include <USBCDC.h>
#include <WiFi.h>
#include <WiFiUdp.h>
#include <esp_wifi.h>
#include <freertos/FreeRTOS.h>
#include <freertos/message_buffer.h>
#include <freertos/semphr.h>
#include <freertos/task.h>

#include "../hub_config.h"
#include "../../core/pfe_console.h"
#include "console_page.h"   // generated by ../../tools/build_console.py

#if !defined(HUB_STA_SSID) && defined(HUB_AP_PASS_IS_DEFAULT)
#  pragma message("HUB_AP_PASS is the example's. Copy hub_secrets.example.h to hub_secrets.h and set your own before this goes anywhere public.")
#endif

namespace {

constexpr size_t HUB_LINE_MAX = 1100;        // the longest line the conductor writes, and then some
constexpr size_t OUT_BUFFER = 24 * 1024; // lines waiting for a serial port
constexpr size_t IN_BUFFER = 4 * 1024;   // lines from WebSocket clients waiting for loop()

pfe::Conductor conductor;
WiFiUDP udp;
USBCDC usbConsole(0);
AsyncWebServer web(80);
AsyncWebSocket socket("/ws");
Preferences prefs;

MessageBufferHandle_t toUsb = nullptr;
MessageBufferHandle_t toUart = nullptr;
MessageBufferHandle_t fromSocket = nullptr;

// A serial port takes console lines only while a console is on it: one
// that has sent a JSON line in the last HUB_CONSOLE_QUIET_MS.
struct Port {
  bool listening = false;
  uint32_t heardMs = 0;
  char line[768];
  size_t len = 0;
  bool overflow = false;
};
Port usbPort, uartPort;

// The panel list for GET /api/panels. The conductor belongs to loop(); the
// web server answers from another task. So loop() writes the list here once
// a second and the handler only copies it, both under the lock.
SemaphoreHandle_t panelsLock = nullptr;
char panelsJson[6144] = "[]";

bool wifiUp = false;
bool udpOpen = false;
bool restartAsked = false;
uint32_t restartAtMs = 0;
uint32_t linesDropped = 0;
volatile uint32_t usbStalls = 0;
volatile bool socketJoined = false;

#ifdef HUB_STA_SSID
constexpr bool ROUTER_MODE = true;
#else
constexpr bool ROUTER_MODE = false;
#endif

// ── Lines out ───────────────────────────────────────────────────────────
void consoleLine(void*, const char* text, size_t len) {
  if (len >= HUB_LINE_MAX) return;
  if (usbPort.listening && xMessageBufferSend(toUsb, text, len, 0) == 0) linesDropped++;
  if (uartPort.listening && xMessageBufferSend(toUart, text, len, 0) == 0) linesDropped++;
  if (socket.count() && socket.availableForWriteAll()) socket.textAll(text, len);
}

void sendPacket(void*, const pfe::Endpoint& to, const uint8_t* data, size_t len) {
  if (!udpOpen) return;
  const IPAddress ip((uint8_t)(to.ip >> 24), (uint8_t)(to.ip >> 16), (uint8_t)(to.ip >> 8), (uint8_t)to.ip);
  if (!udp.beginPacket(ip, to.port)) return;
  udp.write(data, len);
  udp.endPacket();
}

pfe::ConductorIo io() {
  pfe::ConductorIo c;
  c.send = sendPacket;
  c.line = consoleLine;
  return c;
}

// What the hub says about itself in its hello.
char hubInfo[160];
pfe::Console* console = nullptr;

// For people reading the COM jack, and for the console's log pane.
void hubLog(const char* fmt, ...) {
  char msg[160];
  va_list ap;
  va_start(ap, fmt);
  vsnprintf(msg, sizeof(msg), fmt, ap);
  va_end(ap);
  if (!uartPort.listening) Serial.printf("[hub] %s\n", msg);
  conductor.log(msg);
}

// One writer per serial port, so that only this task waits for a laptop.
//
// The core's USBCDC::write() does more than wait: with the port open and
// its buffer full it spins until there is room (cores/esp32/USBCDC.cpp), and
// a task that spins keeps the idle task from running until the watchdog
// restarts the board. A console whose tab has frozen is exactly that. So
// this never hands write() more than the port says it can take, and when
// nothing has moved for half a second it lets the line go and stays quiet
// for a while. Lines are state; the next ones repair it.
void usbWriter(void*) {
  static char line[HUB_LINE_MAX + 2];
  uint32_t quietUntilMs = 0;
  for (;;) {
    size_t n = xMessageBufferReceive(toUsb, line, HUB_LINE_MAX, portMAX_DELAY);
    if (!n || !usbConsole) continue;                    // nobody has the port open
    if (quietUntilMs && (int32_t)(millis() - quietUntilMs) < 0) continue;
    quietUntilMs = 0;
    line[n++] = '\n';
    size_t off = 0;
    uint32_t stuckSinceMs = 0;
    while (off < n && usbConsole) {
      const int space = usbConsole.availableForWrite();
      if (space <= 0) {
        if (!stuckSinceMs) stuckSinceMs = millis() | 1;
        if (millis() - stuckSinceMs > HUB_USB_STALL_MS) {
          quietUntilMs = (millis() + HUB_USB_QUIET_MS) | 1;
          usbStalls++;
          break;
        }
        vTaskDelay(1);
        continue;
      }
      stuckSinceMs = 0;
      const size_t chunk = (size_t)space < n - off ? (size_t)space : n - off;
      const size_t sent = usbConsole.write((const uint8_t*)line + off, chunk);
      if (!sent) break;
      off += sent;
    }
  }
}

void uartWriter(void*) {
  static char line[HUB_LINE_MAX + 2];
  for (;;) {
    size_t n = xMessageBufferReceive(toUart, line, HUB_LINE_MAX, portMAX_DELAY);
    if (!n) continue;
    line[n++] = '\n';
    Serial.write((const uint8_t*)line, n);
  }
}

// ── Lines in ────────────────────────────────────────────────────────────
void handleLine(Port* port, const char* text, size_t len) {
  if (!len || text[0] != '{') return;     // typing in a serial monitor, or noise
  if (port) {
    if (!port->listening) {
      port->listening = true;
      // Whoever just arrived missed everything so far.
      conductor.sendAll();
    }
    port->heardMs = millis();
  }
  const pfe::ConsoleResult res = console->handle(text, len);
  if (res.rebootHub && !restartAsked) {
    restartAsked = true;
    restartAtMs = millis() + 400;
    hubLog("restarting: asked from the console");
  }
}

void feed(Port& port, int c) {
  if (c == '\n' || c == '\r') {
    if (port.len && !port.overflow) handleLine(&port, port.line, port.len);
    port.len = 0;
    port.overflow = false;
    return;
  }
  if (port.len + 1 < sizeof(port.line)) port.line[port.len++] = (char)c;
  else port.overflow = true;
}

void readPorts() {
  for (int budget = 512; budget > 0 && usbConsole.available(); budget--) feed(usbPort, usbConsole.read());
  for (int budget = 512; budget > 0 && Serial.available(); budget--) feed(uartPort, Serial.read());

  static char line[768];
  for (int budget = 16; budget > 0; budget--) {
    const size_t n = xMessageBufferReceive(fromSocket, line, sizeof(line), 0);
    if (!n) break;
    size_t start = 0;
    for (size_t i = 0; i <= n; i++) {
      if (i < n && line[i] != '\n') continue;
      handleLine(nullptr, line + start, i - start);
      start = i + 1;
    }
  }
  if (socketJoined) {
    socketJoined = false;
    conductor.sendAll();
  }

  const uint32_t now = millis();
  for (Port* p : {&usbPort, &uartPort}) {
    if (p->listening && now - p->heardMs > HUB_CONSOLE_QUIET_MS) p->listening = false;
  }
  // A busy panel's line ten times a second is fine over USB and Wi-Fi, and
  // far too much for 115200 baud when the UART is the only console.
  const bool fast = usbPort.listening || socket.count() > 0;
  conductor.setConsoleRate(fast || !uartPort.listening ? 100 : 500);
}

void onSocket(AsyncWebSocket*, AsyncWebSocketClient*, AwsEventType type, void* arg, uint8_t* data, size_t len) {
  if (type == WS_EVT_CONNECT) {
    socketJoined = true;
    return;
  }
  if (type != WS_EVT_DATA) return;
  const AwsFrameInfo* info = (const AwsFrameInfo*)arg;
  // Whole text frames only; a console line is far shorter than one frame.
  if (!info->final || info->index != 0 || info->len != len || info->opcode != WS_TEXT) return;
  xMessageBufferSend(fromSocket, data, len, 0);
}

// ── Wi-Fi ───────────────────────────────────────────────────────────────
#ifndef HUB_STA_SSID
void startHotspot() {
  const IPAddress ip(HUB_AP_IP);
  WiFi.mode(WIFI_AP);
  WiFi.softAPConfig(ip, ip, IPAddress(255, 255, 255, 0));
  const bool up = WiFi.softAP(HUB_AP_SSID, HUB_AP_PASS, HUB_AP_CHANNEL, /*hidden=*/0, HUB_AP_MAX_CONN);
  // 20 MHz: channels 1, 6 and 11 only stay clear of each other at that
  // width, and a few dozen bytes thirty times a second need no more.
  esp_wifi_set_bandwidth(WIFI_IF_AP, WIFI_BW_HT20);
  esp_wifi_set_inactive_time(WIFI_IF_AP, HUB_AP_INACTIVE_S);
  wifiUp = up;
  hubLog("hotspot \"%s\" on channel %d, %s, up to %d devices%s", HUB_AP_SSID, HUB_AP_CHANNEL,
         WiFi.softAPIP().toString().c_str(), HUB_AP_MAX_CONN, up ? "" : " - FAILED to start");
}
#endif

void startServices() {
  if (!udpOpen) udpOpen = udp.begin(pfe::UDP_PORT) == 1;
  MDNS.begin(HUB_HOSTNAME);
  MDNS.addService("http", "tcp", 80);
  static bool webStarted = false;
  if (webStarted) return;
  webStarted = true;
  socket.onEvent(onSocket);
  web.addHandler(&socket);
  web.on("/", HTTP_GET, [](AsyncWebServerRequest* req) {
    AsyncWebServerResponse* res = req->beginResponse(200, "text/html; charset=utf-8", CONSOLE_PAGE_GZ, CONSOLE_PAGE_GZ_LEN);
    res->addHeader("Content-Encoding", "gzip");
    res->addHeader("Cache-Control", "no-cache");
    req->send(res);
  });
  web.on("/api/status", HTTP_GET, [](AsyncWebServerRequest* req) {
    char body[360];
    const pfe::Stats& st = conductor.stats();
    snprintf(body, sizeof(body),
             "{\"fw\":\"%s\",\"proto\":%u,\"uptime_s\":%lu,\"mode\":\"%s\",\"panels\":%d,\"online\":%d,"
             "\"stations\":%d,\"heap\":%lu,\"rx\":%lu,\"tx\":%lu,\"bad\":%lu,\"lines_dropped\":%lu,"
             "\"usb_stalls\":%lu}",
             HUB_VERSION, (unsigned)pfe::PROTO_VERSION, (unsigned long)(millis() / 1000),
             ROUTER_MODE ? "router" : "hotspot", conductor.panelCount(), conductor.onlineCount(),
             ROUTER_MODE ? 0 : (int)WiFi.softAPgetStationNum(), (unsigned long)ESP.getFreeHeap(),
             (unsigned long)st.rx, (unsigned long)st.tx, (unsigned long)st.bad, (unsigned long)linesDropped,
             (unsigned long)usbStalls);
    req->send(200, "application/json", body);
  });
  web.on("/api/panels", HTTP_GET, [](AsyncWebServerRequest* req) {
    static char copy[sizeof(panelsJson) + 16];
    xSemaphoreTake(panelsLock, portMAX_DELAY);
    snprintf(copy, sizeof(copy), "{\"panels\":%s}", panelsJson);
    xSemaphoreGive(panelsLock);
    req->send(200, "application/json", copy);
  });
  web.onNotFound([](AsyncWebServerRequest* req) { req->send(404, "text/plain", "not here"); });
  web.begin();
}

void wifiTick() {
  static bool started = false;
#ifdef HUB_STA_SSID
  if (!started) {
    started = true;
    WiFi.mode(WIFI_STA);
    WiFi.setHostname(HUB_HOSTNAME);
    WiFi.setSleep(false);              // modem sleep adds up to a beacon of latency to every STATE
    WiFi.setAutoReconnect(true);
    WiFi.begin(HUB_STA_SSID, HUB_STA_PASS);
    hubLog("router mode: joining \"%s\"", HUB_STA_SSID);
  }
  const bool up = WiFi.status() == WL_CONNECTED;
  if (up && !wifiUp) {
    hubLog("on \"%s\" as %s, http://%s.local/", HUB_STA_SSID, WiFi.localIP().toString().c_str(), HUB_HOSTNAME);
    udp.stop();
    udpOpen = false;
    startServices();
  } else if (!up && wifiUp) {
    hubLog("lost \"%s\", joining again", HUB_STA_SSID);
  }
  wifiUp = up;
#else
  if (!started && millis() >= HUB_AP_START_DELAY_MS) {
    started = true;
    startHotspot();
    startServices();
  }
#endif
}

// ── Flash ───────────────────────────────────────────────────────────────
void loadSetup() {
  static uint8_t blob[pfe::SAVE_MAX];
  if (!prefs.begin("pfe", true)) return;
  const size_t n = prefs.getBytes("setup", blob, sizeof(blob));
  prefs.end();
  if (!n) { Serial.println("[hub] no saved setup: starting empty"); return; }
  const bool ok = conductor.load(blob, n);
  Serial.printf("[hub] saved setup: %u bytes, %s, %d panels known\n", (unsigned)n,
                ok ? "loaded" : "NOT understood (ignored)", conductor.panelCount());
}

void saveSetupIfDue() {
  if (!conductor.persistDirty() || millis() - conductor.persistChangedMs() < HUB_SAVE_AFTER_MS) return;
  static uint8_t blob[pfe::SAVE_MAX];
  const size_t n = conductor.save(blob, sizeof(blob));
  conductor.clearPersistDirty();
  if (!n || !prefs.begin("pfe", false)) { hubLog("setup NOT saved (flash)"); return; }
  const size_t written = prefs.putBytes("setup", blob, n);
  prefs.end();
  if (written != n) hubLog("setup NOT saved: %u of %u bytes written", (unsigned)written, (unsigned)n);
}

}  // namespace

void setup() {
  Serial.begin(115200);   // UART0 = the COM jack

  toUsb = xMessageBufferCreate(OUT_BUFFER);
  toUart = xMessageBufferCreate(OUT_BUFFER);
  fromSocket = xMessageBufferCreate(IN_BUFFER);
  panelsLock = xSemaphoreCreateMutex();

  // USB first, so the laptop has the port while the Wi-Fi comes up.
  USB.productName(HUB_USB_NAME);
  USB.manufacturerName("Patternflow");
  usbConsole.begin();
  USB.begin();

  delay(200);
  Serial.printf("\n\n[hub] Patternflow Ensemble hub v%s, PFE/%u on UDP %u\n", HUB_VERSION,
                (unsigned)pfe::PROTO_VERSION, (unsigned)pfe::UDP_PORT);

  conductor.begin(io(), millis());
  loadSetup();

  snprintf(hubInfo, sizeof(hubInfo), "\"fw\":\"%s\",\"hub\":\"esp32-s3\",\"mode\":\"%s\",\"ssid\":\"%s\"",
           HUB_VERSION, ROUTER_MODE ? "router" : "hotspot",
#ifdef HUB_STA_SSID
           HUB_STA_SSID
#else
           HUB_AP_SSID
#endif
  );
  static pfe::Console theConsole(conductor, io(), hubInfo);
  console = &theConsole;

  xTaskCreatePinnedToCore(usbWriter, "pfe-usb", 4096, nullptr, 2, nullptr, 0);
  xTaskCreatePinnedToCore(uartWriter, "pfe-uart", 4096, nullptr, 2, nullptr, 0);

  if (!ROUTER_MODE) {
    Serial.printf("[hub] hotspot \"%s\" starts in %d s (so panels from before a restart let go)\n",
                  HUB_AP_SSID, HUB_AP_START_DELAY_MS / 1000);
  }
}

void loop() {
  wifiTick();

  // Up to 32 datagrams a pass: twenty-four panels reporting at once must
  // not queue behind each other for a second.
  uint8_t packet[pfe::MAX_PACKET];
  for (int budget = 32; udpOpen && budget > 0; budget--) {
    const int size = udp.parsePacket();
    if (size <= 0) break;
    const int n = udp.read(packet, sizeof(packet));
    if (n <= 0) continue;
    const IPAddress ip = udp.remoteIP();
    pfe::Endpoint from;
    from.ip = ((uint32_t)ip[0] << 24) | ((uint32_t)ip[1] << 16) | ((uint32_t)ip[2] << 8) | ip[3];
    from.port = udp.remotePort();
    conductor.onPacket(from, packet, (size_t)n, millis());
  }

  readPorts();
  conductor.tick(millis());
  saveSetupIfDue();

  static uint32_t lastCleanup = 0;
  if (millis() - lastCleanup > 1000) {
    lastCleanup = millis();
    socket.cleanupClients();
    static char fresh[sizeof(panelsJson)];
    pfe::Out out(fresh, sizeof(fresh));
    conductor.writePanels(out);
    if (!out.overflow) {
      xSemaphoreTake(panelsLock, portMAX_DELAY);
      memcpy(panelsJson, fresh, out.len + 1);
      xSemaphoreGive(panelsLock);
    }
  }

  if (restartAsked && (int32_t)(millis() - restartAtMs) >= 0) ESP.restart();
  delay(1);
}
