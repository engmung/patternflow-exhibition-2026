// SPDX-License-Identifier: CC-BY-SA-4.0
// Pattern: HANYEONGHOE — Pattern Lab layer-stack composition (3 layers)
//
// SCAFFOLD (deterministic, generated by Pattern Lab — do not hand-edit):
// buffers, shared-knob accumulation, ramp LUTs, pixel art, masks, blending
// and compositing are finished code. ONLY the "namespace L<i>" blocks between
// the >>> markers are translated from each layer's JavaScript; stubs compile
// to a black layer until replaced.
//
// Layers (bottom → top):
//   L0. Pixel 1 (pixel, normal, 100%)
//   L1. Cloud (code, normal, 100%)
//   L2. flower (code, normal, 100%)
#pragma once

// ===== Patternflow pattern =====
// Title:    HANYEONGHOE
// Author:   @engmung
// Date:     2026-09-16
// SPDX-License-Identifier: CC-BY-SA-4.0
// ===============================
#include <Arduino.h>
#include "config.h"
#include "src/core_display.h"
#include "src/core_encoders.h"
#include "src/core_canvas.h"
#include "src/core_mem.h"
#include "src/core_math.h"
#include "src/core_color.h"
#include "src/core_noise.h"
#include "src/core_params.h"

namespace LabStack_HANYEONGHOE {

const char* NAME = "HANYEONGHOE";
const char* const KNOB_LABELS[4] = {"BloomSize", "WindSpeed", "StemSway", "Unused"};
// Knobs run through PFParams: the MQTT absolute bus (Director / Show
// manager, 0..1000) can pin any of them deterministically.
constexpr bool ABSOLUTE_READY = true;

constexpr int FRAME_W = 64;
constexpr int FRAME_H = 128;
constexpr int PIX_N = FRAME_W * FRAME_H;
constexpr int LAYER_N = 3;

// ── Shared knobs: encoder detents become values HERE, once, for every layer ──
static const float KNOB_MIN[4]  = {0.5f, 0.2f, -2.0f, 0.0f};
static const float KNOB_MAX[4]  = {6.0f, 5.0f, 2.0f, 1.0f};
static const float KNOB_STEP[4] = {0.11458f, 0.1f, 0.08333f, 0.02083f}; // value per detent — two turns cross the range
static float knobVal[4]  = {6.0f, 4.21f, 2.0f, 0.494f};
static float knobNorm[4] = {1.0f, 0.83542f, 1.0f, 0.494f};

// ── Layer buffers (RGBA8, PSRAM-first, allocated once in setup) ──
static uint8_t* layerBuf[LAYER_N] = {nullptr, nullptr, nullptr};

// ── Composite plan (bottom → top; blend: 0 normal, 1 add, 2 multiply, 3 screen) ──
constexpr int GROUP_N = 3;
static const uint8_t G_LAYER[3]   = {0, 1, 2};
static const float   G_OPACITY[3] = {1.0f, 1.0f, 1.0f};
static const uint8_t G_BLEND[3]   = {0, 0, 0};
static const uint8_t G_MASK_AT[3] = {0, 0, 0};
static const uint8_t G_MASK_N[3]  = {0, 0, 0};
static const uint8_t MASK_LAYER[1]  = {0};
static const uint8_t MASK_PXART[1]  = {0};
static const uint8_t MASK_INVERT[1] = {0};

// ── L0 "Pixel 1": pixel art, RLE {count,r,g,b,a} — decoded once in setup ──
static const uint8_t L0_RLE[7820] = {
  9,49,111,211,255,4,54,99,171,255,4,29,97,205,255,5,54,99,171,255,
  106,49,111,211,255,1,54,99,171,255,40,49,111,211,255,1,24,100,220,255,
  3,49,111,211,255,5,24,100,220,255,4,53,120,227,255,10,24,100,220,255,
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  128,0,36,30,255,1,4,36,0,255,60,0,36,30,255,3,4,36,0,255
};

// ── L1 "Cloud": ramp LUT (RGBA, alpha included — baked by Pattern Lab, copy-proof) ──
static const uint8_t L1_RAMP[256][4] = {
  {0,0,0,0},{18,18,18,53},{63,63,63,105},{114,114,114,158},{169,169,169,211},{218,218,218,255},{213,213,213,255},{208,208,208,255},
  {203,203,203,255},{199,199,199,255},{194,194,194,255},{194,194,194,255},{194,194,194,255},{194,194,194,255},{194,194,194,255},{194,194,194,255},
  {194,194,194,255},{194,194,194,255},{194,194,194,255},{194,194,194,255},{194,194,194,255},{194,194,194,255},{194,194,194,255},{194,194,194,255},
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  {252,252,252,255},{252,252,252,255},{253,253,253,255},{253,253,253,255},{254,254,254,255},{254,254,254,255},{255,255,255,255},{255,255,255,255}
};
static inline void L1_setValue(int x, int y, float v) {
  if ((unsigned)x >= (unsigned)FRAME_W || (unsigned)y >= (unsigned)FRAME_H) return;
  if (!(v > 0.0f)) v = 0.0f; else if (v > 1.0f) v = 1.0f;
  const uint8_t* c = L1_RAMP[(int)(v * 255.0f + 0.5f)];
  uint8_t* p = layerBuf[1] + (((size_t)y * FRAME_W + x) << 2);
  p[0] = c[0]; p[1] = c[1]; p[2] = c[2]; p[3] = c[3];
}
static inline void L1_setPixel(int x, int y, uint8_t r, uint8_t g, uint8_t b) {
  if ((unsigned)x >= (unsigned)FRAME_W || (unsigned)y >= (unsigned)FRAME_H) return;
  uint8_t* p = layerBuf[1] + (((size_t)y * FRAME_W + x) << 2);
  p[0] = r; p[1] = g; p[2] = b; p[3] = 255;
}

// ── L2 "flower": ramp LUT (RGBA, alpha included — baked by Pattern Lab, copy-proof) ──
static const uint8_t L2_RAMP[256][4] = {
  {0,0,0,0},{0,50,6,53},{0,99,12,105},{0,149,17,158},{0,198,23,211},{0,239,28,255},{0,236,29,255},{0,232,30,255},
  {0,228,30,255},{0,225,31,255},{0,221,32,255},{0,217,32,255},{0,214,33,255},{0,210,34,255},{0,206,35,255},{0,203,35,255},
  {0,199,36,255},{0,195,37,255},{0,192,37,255},{0,188,38,255},{0,184,39,255},{0,181,40,255},{0,177,40,255},{0,173,41,255},
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  {255,236,0,255},{255,236,0,255},{255,235,0,255},{255,235,0,255},{255,235,0,255},{255,234,0,255},{255,234,0,255},{255,234,0,255}
};
static inline void L2_setValue(int x, int y, float v) {
  if ((unsigned)x >= (unsigned)FRAME_W || (unsigned)y >= (unsigned)FRAME_H) return;
  if (!(v > 0.0f)) v = 0.0f; else if (v > 1.0f) v = 1.0f;
  const uint8_t* c = L2_RAMP[(int)(v * 255.0f + 0.5f)];
  uint8_t* p = layerBuf[2] + (((size_t)y * FRAME_W + x) << 2);
  p[0] = c[0]; p[1] = c[1]; p[2] = c[2]; p[3] = c[3];
}
static inline void L2_setPixel(int x, int y, uint8_t r, uint8_t g, uint8_t b) {
  if ((unsigned)x >= (unsigned)FRAME_W || (unsigned)y >= (unsigned)FRAME_H) return;
  uint8_t* p = layerBuf[2] + (((size_t)y * FRAME_W + x) << 2);
  p[0] = r; p[1] = g; p[2] = b; p[3] = 255;
}

// >>> LAYER 1 TRANSLATION BEGIN <<<
namespace L1 {
  struct Dab {
    float ox;
    float oy;
    float rx;
    float ry;
    float phase;
    float pulseFreq;
  };

  struct Cloud {
    float x;
    float y;
    float rx;
    float ry;
    float threshold;
    float baseTone;
    float alphaRate;
    Dab dabs[16];
  };

  static const int L1_NUM_CLOUDS = 6;
  static const int L1_DABS_PER_CLOUD = 16;
  static Cloud clouds[L1_NUM_CLOUDS];

  static float wind = 0.0f;
  static float breathe = 0.0f;
  static float count = 5.177f;
  static float scale = 1.778f;

  static const float L1_MIN_X = -0.50f;
  static const float L1_MAX_X = 1.50f;
  static const float L1_SPAN = 2.00f;
  static const float L1_JITTER = 1.0f + (-1.671f) * 0.3f; // 0.4987f

  static float* transBuffer = nullptr;
  static float* toneBuffer = nullptr;
  static uint8_t* countBuffer = nullptr;

  static float hash(float n) {
    float s = sinf(n * 127.1f) * 43758.5453f;
    return s - floorf(s);
  }

  void setup() {
    PFMath::buildSinLUT();

    int maxCloudY = (int)((float)FRAME_H * 0.52f);
    if (maxCloudY > FRAME_H) maxCloudY = FRAME_H;
    int bufSize = FRAME_W * maxCloudY;

    if (!transBuffer) {
      transBuffer = PFMem::allocFloats(bufSize);
    }
    if (!toneBuffer) {
      toneBuffer = PFMem::allocFloats(bufSize);
    }
    if (!countBuffer) {
      countBuffer = (uint8_t*)PFMem::allocFloats((bufSize + sizeof(float) - 1) / sizeof(float));
    }

    wind = 0.0f;
    breathe = 0.0f;

    struct ParentCloudDef {
      float x;
      float y;
      float rx;
      float ry;
      float seed;
      float threshold;
      float baseTone;
      float alphaRate;
    };

    const ParentCloudDef parentDefs[L1_NUM_CLOUDS] = {
      { -0.15f, 0.17f, 0.22f, 0.09f, 15.2f, 1.0f, 0.95f, 0.62f },
      {  0.15f, 0.24f, 0.28f, 0.11f, 48.7f, 2.0f, 0.72f, 0.44f },
      {  0.45f, 0.16f, 0.25f, 0.10f, 82.1f, 3.0f, 0.86f, 0.55f },
      {  0.75f, 0.25f, 0.30f, 0.12f, 33.9f, 4.0f, 0.92f, 0.60f },
      {  1.05f, 0.18f, 0.24f, 0.09f, 61.3f, 5.0f, 0.68f, 0.42f },
      {  1.35f, 0.23f, 0.27f, 0.11f, 94.8f, 6.0f, 0.82f, 0.50f }
    };

    for (int c = 0; c < L1_NUM_CLOUDS; c++) {
      clouds[c].x = parentDefs[c].x;
      clouds[c].y = parentDefs[c].y;
      clouds[c].rx = parentDefs[c].rx;
      clouds[c].ry = parentDefs[c].ry;
      clouds[c].threshold = parentDefs[c].threshold;
      clouds[c].baseTone = parentDefs[c].baseTone;
      clouds[c].alphaRate = parentDefs[c].alphaRate;

      for (int i = 0; i < L1_DABS_PER_CLOUD; i++) {
        float s = parentDefs[c].seed + (float)i * 7.31f;
        float ang = hash(s) * TWO_PI;
        float rad = sqrtf(hash(s + 1.1f));

        float coreBoost = 1.35f - rad * 0.35f;
        float baseRx = (0.075f + hash(s + 2.2f) * 0.035f) * coreBoost;
        float baseRy = (0.022f + hash(s + 3.3f) * 0.012f) * coreBoost;

        clouds[c].dabs[i].ox = cosf(ang) * rad * parentDefs[c].rx * 0.85f;
        clouds[c].dabs[i].oy = sinf(ang) * rad * parentDefs[c].ry * 0.85f;
        clouds[c].dabs[i].rx = baseRx;
        clouds[c].dabs[i].ry = baseRy;
        clouds[c].dabs[i].phase = hash(s + 5.5f) * TWO_PI;
        clouds[c].dabs[i].pulseFreq = 0.7f + hash(s + 6.6f) * 0.6f;
      }
    }
  }

  void update(float dt, const InputFrame& input) {
    if (!transBuffer || !toneBuffer || !countBuffer) return;

    float speed = knobVal[1];
    wind += dt * speed * 0.11f;
    if (wind >= L1_SPAN) wind = fmodf(wind, L1_SPAN);
    else if (wind < 0.0f) wind = fmodf(wind, L1_SPAN) + L1_SPAN;

    breathe += dt * 1.1f;
    if (breathe >= TWO_PI * 10.0f) breathe = fmodf(breathe, TWO_PI * 10.0f);

    count = knobVal[0];
    scale = knobVal[2];
  }

  void draw() {
    if (!transBuffer || !toneBuffer || !countBuffer) return;

    int maxCloudY = (int)((float)FRAME_H * 0.52f);
    if (maxCloudY > FRAME_H) maxCloudY = FRAME_H;
    int bufferSize = FRAME_W * maxCloudY;

    for (int i = 0; i < bufferSize; i++) {
      transBuffer[i] = 1.0f;
      toneBuffer[i] = 0.0f;
      countBuffer[i] = 0;
    }

    const float fW = (float)FRAME_W;
    const float fH = (float)FRAME_H;
    const float invW = 1.0f / (float)(FRAME_W - 1);
    const float invH = 1.0f / (float)(FRAME_H - 1);
    const float sqrtScale = sqrtf(scale);

    for (int c = 0; c < L1_NUM_CLOUDS; c++) {
      const Cloud& cloud = clouds[c];
      if (cloud.threshold > count) continue;

      float rawX = cloud.x + wind;
      float baseCx = fmodf(rawX - L1_MIN_X, L1_SPAN);
      if (baseCx < 0.0f) baseCx += L1_SPAN;
      baseCx += L1_MIN_X;

      float maxCloudRadius = cloud.rx * scale * 2.0f;
      float alphaRate = cloud.alphaRate;
      float baseTone = cloud.baseTone;

      for (int wrap = -1; wrap <= 1; wrap++) {
        float cx = baseCx + (float)wrap * L1_SPAN;

        if (cx + maxCloudRadius < 0.0f || cx - maxCloudRadius > 1.0f) continue;

        for (int d = 0; d < L1_DABS_PER_CLOUD; d++) {
          const Dab& dab = cloud.dabs[d];

          float p = dab.phase + breathe * dab.pulseFreq;
          float driftX = PFMath::fastCos(p) * 0.007f;
          float driftY = PFMath::fastSin(p * 1.3f) * 0.004f;

          float dabPosX = cx + (dab.ox + driftX) * L1_JITTER * scale;
          float dabPosY = cloud.y + (dab.oy + driftY) * L1_JITTER * scale;

          float sizePulse = 1.0f + PFMath::fastSin(p * 1.4f) * 0.10f;
          float rX = dab.rx * sqrtScale * sizePulse;
          float rY = dab.ry * sqrtScale * sizePulse;

          int minPxX = (int)floorf((dabPosX - rX) * fW);
          int maxPxX = (int)ceilf((dabPosX + rX) * fW);
          int minPxY = (int)floorf((dabPosY - rY) * fH);
          int maxPxY = (int)ceilf((dabPosY + rY) * fH);

          if (maxPxX < 0 || minPxX >= FRAME_W || maxPxY < 0 || minPxY >= maxCloudY) {
            continue;
          }

          int clampMinX = minPxX < 0 ? 0 : minPxX;
          int clampMaxX = maxPxX >= FRAME_W ? FRAME_W - 1 : maxPxX;
          int clampMinY = minPxY < 0 ? 0 : minPxY;
          int clampMaxY = maxPxY >= maxCloudY ? maxCloudY - 1 : maxPxY;

          float invRxSq = 1.0f / (rX * rX);
          float invRySq = 1.0f / (rY * rY);

          for (int py = clampMinY; py <= clampMaxY; py++) {
            float ny = (float)py * invH;
            float dy = ny - dabPosY;
            float dySqNorm = (dy * dy) * invRySq;
            if (dySqNorm >= 1.0f) continue;

            float maxDx = sqrtf((1.0f - dySqNorm) / invRxSq);

            int spanMinX = (int)floorf((dabPosX - maxDx) * (float)(FRAME_W - 1));
            int spanMaxX = (int)ceilf((dabPosX + maxDx) * (float)(FRAME_W - 1));

            if (spanMinX < clampMinX) spanMinX = clampMinX;
            if (spanMaxX > clampMaxX) spanMaxX = clampMaxX;
            if (spanMinX > spanMaxX) continue;

            int rowOffset = py * FRAME_W;

            for (int px = spanMinX; px <= spanMaxX; px++) {
              float nx = (float)px * invW;
              float dx = nx - dabPosX;
              float distNorm = (dx * dx) * invRxSq + dySqNorm;

              if (distNorm < 1.0f) {
                int idx = rowOffset + px;
                float alpha = (1.0f - distNorm) * alphaRate;
                transBuffer[idx] *= (1.0f - alpha);

                if (baseTone > toneBuffer[idx]) {
                  toneBuffer[idx] = baseTone;
                }

                if (countBuffer[idx] < 8) countBuffer[idx]++;
              }
            }
          }
        }
      }
    }

    for (int py = 0; py < maxCloudY; py++) {
      float ny = (float)py * invH;
      int rowOffset = py * FRAME_W;

      float falloff = 1.0f;
      if (ny > 0.40f) {
        falloff = 1.0f - (ny - 0.40f) * 8.33f;
        if (falloff < 0.0f) falloff = 0.0f;
      }

      for (int px = 0; px < FRAME_W; px++) {
        int idx = rowOffset + px;
        uint8_t cNum = countBuffer[idx];

        if (cNum > 0) {
          float densityVal = 1.0f - transBuffer[idx];
          float targetTone = toneBuffer[idx];
          float layerSheen = (float)cNum * 0.025f;

          float v = ((densityVal * targetTone) + layerSheen) * falloff;
          if (v > 1.0f) v = 1.0f;
          else if (v < 0.0f) v = 0.0f;
          L1_setValue(px, py, v);
        } else {
          L1_setValue(px, py, 0.0f);
        }
      }
    }

    for (int py = maxCloudY; py < FRAME_H; py++) {
      for (int px = 0; px < FRAME_W; px++) {
        L1_setValue(px, py, 0.0f);
      }
    }
  }
}
// >>> LAYER 1 TRANSLATION END <<<

// >>> LAYER 2 TRANSLATION BEGIN <<<
namespace L2 {
  struct Flower {
    float rx;
    float fx;
    float fy;
    float s;
    bool isMain;
  };

  struct PurpleFlower {
    float rx;
    float bx;
    float by;
  };

  struct GrassBlade {
    float x0;
    float y0;
    float x1;
    float y1;
  };

  static const int L2_NUM_FLOWERS = 14;
  static const Flower flowers[L2_NUM_FLOWERS] = {
    { 5.0f,  5.0f,  88.0f,  1.1f, false },
    { 7.0f,  6.0f,  78.0f,  1.0f, false },
    { 9.0f,  9.0f,  80.0f,  1.2f, true  },
    { 11.0f, 11.0f, 91.0f,  1.1f, false },
    { 15.0f, 15.0f, 76.0f,  1.3f, true  },
    { 17.0f, 17.0f, 86.0f,  1.1f, false },
    { 17.0f, 16.0f, 97.0f,  1.1f, false },
    { 20.0f, 20.0f, 89.0f,  1.1f, false },
    { 22.0f, 22.0f, 68.0f,  1.6f, true  },
    { 27.0f, 27.0f, 100.0f, 1.2f, false },
    { 28.0f, 28.0f, 76.0f,  1.4f, true  },
    { 32.0f, 33.0f, 80.0f,  1.3f, true  },
    { 42.0f, 43.0f, 116.0f, 1.2f, false },
    { 55.0f, 56.0f, 120.0f, 1.2f, false }
  };

  static const int L2_NUM_PURPLE = 13;
  static const PurpleFlower purpleFlowers[L2_NUM_PURPLE] = {
    { 14.0f, 14.0f, 106.0f },
    { 16.0f, 16.0f, 104.0f },
    { 22.0f, 22.0f, 103.0f },
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    { 59.0f, 59.0f, 114.0f }
  };

  static const int L2_NUM_GRASS = 20;
  static const GrassBlade grassBlades[L2_NUM_GRASS] = {
    { 2.0f, 127.0f, 8.0f, 108.0f },   { 4.0f, 127.0f, 3.0f, 101.0f },
    { 6.0f, 127.0f, 12.0f, 105.0f },  { 8.0f, 127.0f, 5.0f, 111.0f },
    { 12.0f, 127.0f, 16.0f, 103.0f }, { 14.0f, 127.0f, 9.0f, 107.0f },
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    { 58.0f, 127.0f, 62.0f, 113.0f }, { 60.0f, 127.0f, 54.0f, 109.0f }
  };

  static float windTime = 0.0f;
  static float bloom = 1.0f;
  static float sway = 2.0f;

  static void plot(float x, float y, float v) {
    int px = (int)floorf(x);
    int py = (int)floorf(y);
    if (px >= 0 && px < FRAME_W && py >= 0 && py < FRAME_H) {
      L2_setValue(px, py, v);
    }
  }

  static void drawBrushLine(float x0, float y0, float x1, float y1, float radius, float val) {
    float dxLine = x1 - x0;
    float dyLine = y1 - y0;
    float dist = sqrtf(dxLine * dxLine + dyLine * dyLine);
    int steps = (int)floorf(dist * 2.0f);
    if (steps < 1) steps = 1;

    int r = (int)floorf(radius);
    float radSq = radius * radius;
    float invSteps = 1.0f / (float)steps;

    for (int i = 0; i <= steps; i++) {
      float frac = (float)i * invSteps;
      float cx = x0 + dxLine * frac;
      float cy = y0 + dyLine * frac;

      for (int dy = -r; dy <= r; dy++) {
        for (int dx = -r; dx <= r; dx++) {
          if ((float)(dx * dx + dy * dy) <= radSq) {
            plot(cx + (float)dx, cy + (float)dy, val);
          }
        }
      }
    }
  }

  static void drawDab(float cx, float cy, float rx, float ry, float val) {
    int startX = (int)floorf(cx - rx);
    int endX = (int)ceilf(cx + rx);
    int startY = (int)floorf(cy - ry);
    int endY = (int)ceilf(cy + ry);

    float invRx = 1.0f / rx;
    float invRy = 1.0f / ry;

    for (int py = startY; py <= endY; py++) {
      float dy = ((float)py - cy) * invRy;
      float dySq = dy * dy;
      if (dySq > 1.0f) continue;

      for (int px = startX; px <= endX; px++) {
        float dx = ((float)px - cx) * invRx;
        if (dx * dx + dySq <= 1.0f) {
          plot((float)px, (float)py, val);
        }
      }
    }
  }

  static void drawRapeFlowerHead(float cx, float cy, float scale, bool isMain) {
    float s = scale * bloom;
    float coreVal = isMain ? 0.88f : 0.65f;
    float petalVal = isMain ? 0.98f : 0.72f;
    float calyxVal = 0.32f;

    drawDab(cx, cy + 1.2f * s, 1.6f * s, 0.8f * s, calyxVal);
    drawDab(cx, cy + 0.3f * s, 1.8f * s, 1.2f * s, coreVal);

    static const float petals[5][4] = {
      {  0.0f, -1.8f, 1.1f, 1.4f },
      { -1.4f, -1.4f, 1.0f, 1.3f },
      {  1.4f, -1.4f, 1.0f, 1.3f },
      { -2.4f, -0.4f, 1.1f, 1.1f },
      {  2.4f, -0.4f, 1.1f, 1.1f }
    };

    for (int i = 0; i < 5; i++) {
      drawDab(cx + petals[i][0] * s, cy + petals[i][1] * s, petals[i][2] * s, petals[i][3] * s, petalVal);
    }
  }

  static void drawCompactPurpleFlower(float cx, float cy, float val) {
    float s = bloom * 0.95f;

    drawDab(cx, cy, 1.3f * s, 0.8f * s, val);
    drawDab(cx - 1.3f * s, cy - 0.2f * s, 0.8f * s, 0.5f * s, val + 0.05f);
    drawDab(cx + 1.3f * s, cy - 0.2f * s, 0.8f * s, 0.5f * s, val + 0.05f);
    drawDab(cx, cy - 0.8f * s, 0.6f * s, 0.6f * s, val + 0.03f);
  }

  void setup() {
    PFMath::buildSinLUT();
    windTime = 0.0f;
  }

  void update(float dt, const InputFrame& input) {
    windTime += dt * knobVal[1] * 2.0f;
    if (windTime >= TWO_PI * 100.0f) {
      windTime = fmodf(windTime, TWO_PI * 100.0f);
    }

    float rawBloom = knobVal[0];
    float tNorm = (rawBloom - 0.5f) / 5.5f;
    if (tNorm < 0.0f) tNorm = 0.0f;
    else if (tNorm > 1.0f) tNorm = 1.0f;
    bloom = 0.65f + tNorm * 0.35f;

    sway = knobVal[2];
  }

  void draw() {
    for (int y = 0; y < FRAME_H; y++) {
      for (int x = 0; x < FRAME_W; x++) {
        L2_setValue(x, y, 0.0f);
      }
    }

    float swayFactor = 1.0f + sway * 0.4f;

    for (int i = 0; i < L2_NUM_FLOWERS; i++) {
      const Flower& fl = flowers[i];
      float swayOffset = PFMath::fastSin(windTime + (float)i * 1.5f) * 1.1f * swayFactor;
      float stemVal = 0.22f + (float)(i % 3) * 0.03f;
      drawBrushLine(fl.rx, 127.0f, fl.fx + swayOffset, fl.fy + 1.5f, 0.7f, stemVal);
    }

    for (int k = 0; k < L2_NUM_PURPLE; k++) {
      const PurpleFlower& pf = purpleFlowers[k];
      float swayBud = PFMath::fastSin(windTime * 1.2f + (float)k * 1.8f) * 0.9f * swayFactor;
      drawBrushLine(pf.rx, 127.0f, pf.bx + swayBud, pf.by + 1.2f, 0.5f, 0.23f);
    }

    for (int j = 0; j < L2_NUM_GRASS; j++) {
      const GrassBlade& gb = grassBlades[j];
      float swayGrass = PFMath::fastSin(windTime * 1.3f + (float)j) * 0.6f;
      float bladeVal = 0.06f + (float)((j * 7) % 11) * 0.01f;
      drawBrushLine(gb.x0, gb.y0, gb.x1 + swayGrass, gb.y1, 0.7f, bladeVal);
    }

    for (int k = 0; k < L2_NUM_PURPLE; k++) {
      const PurpleFlower& pf = purpleFlowers[k];
      float swayBud = PFMath::fastSin(windTime * 1.2f + (float)k * 1.8f) * 0.9f * swayFactor;
      float hx = pf.bx + swayBud;
      float hy = pf.by;
      float baseTone = 0.38f + (float)(k % 4) * 0.03f;
      drawCompactPurpleFlower(hx, hy, baseTone);
    }

    for (int i = 0; i < L2_NUM_FLOWERS; i++) {
      const Flower& fl = flowers[i];
      float swayOffset = PFMath::fastSin(windTime + (float)i * 1.5f) * 1.1f * swayFactor;
      drawRapeFlowerHead(fl.fx + swayOffset, fl.fy, fl.s, fl.isMain);
    }
  }
}
// >>> LAYER 2 TRANSLATION END <<<

// ── Deterministic pipeline (do not edit) ──
static void rleDecode(const uint8_t* rle, size_t len, uint8_t* out) {
  size_t o = 0;
  const size_t cap = (size_t)PIX_N * 4;
  for (size_t i = 0; i + 4 < len && o < cap; i += 5) {
    for (int k = 0; k < rle[i] && o < cap; k++) {
      out[o++] = rle[i + 1]; out[o++] = rle[i + 2]; out[o++] = rle[i + 3]; out[o++] = rle[i + 4];
    }
  }
}

// Binary mask test — identical to the Pattern Lab preview: pixel art is "on"
// where something was drawn (alpha >= 0.5); code layers where ramp-colored
// luminance x alpha crosses 0.5.
static inline bool maskOn(const uint8_t* p, bool pixelArt, bool invert) {
  bool on;
  if (pixelArt) on = p[3] >= 128;
  else on = (0.2126f * p[0] + 0.7152f * p[1] + 0.0722f * p[2]) * (p[3] / 255.0f) >= 127.5f;
  return invert ? !on : on;
}

static void recolorBuffer(uint8_t* buf, const uint8_t lut[256][4]) {
  for (int i = 0; i < PIX_N; i++) {
    uint8_t* p = buf + (size_t)i * 4;
    if (p[3] == 0) continue;
    int lum = (int)(0.2126f * p[0] + 0.7152f * p[1] + 0.0722f * p[2] + 0.5f);
    if (lum > 255) lum = 255;
    const uint8_t* c = lut[lum];
    p[0] = c[0]; p[1] = c[1]; p[2] = c[2]; p[3] = c[3];
  }
}

void setup() {
  for (int i = 0; i < LAYER_N; i++)
    if (!layerBuf[i]) layerBuf[i] = (uint8_t*)PFMem::alloc((size_t)PIX_N * 4);
  for (int i = 0; i < LAYER_N; i++)
    if (!layerBuf[i]) return; // allocation failed → draw() degrades to blank
  rleDecode(L0_RLE, sizeof(L0_RLE), layerBuf[0]);
  L1::setup();
  L2::setup();
}

void update(float dt, const InputFrame& input) {
  for (int i = 0; i < 4; i++) {
    // Absolute bus (when held) > audio/weather > encoder deltas — one call,
    // same clamping the old delta loop did.
    PFParams::apply(input, i, &knobVal[i], KNOB_MIN[i], KNOB_MAX[i], KNOB_STEP[i]);
    knobNorm[i] = (knobVal[i] - KNOB_MIN[i]) / (KNOB_MAX[i] - KNOB_MIN[i]);
  }
  L1::update(dt, input);
  L2::update(dt, input);
}

void draw() {
  PFCanvas::setFrame(FRAME_W, FRAME_H);
  for (int i = 0; i < LAYER_N; i++)
    if (!layerBuf[i]) { PFCanvas::present(); return; }

  memset(layerBuf[1], 0, (size_t)PIX_N * 4);
  L1::draw();
  memset(layerBuf[2], 0, (size_t)PIX_N * 4);
  L2::draw();

  // Composite bottom → top over the panel's black — same math as the web preview.
  for (int y = 0; y < FRAME_H; y++) {
    for (int x = 0; x < FRAME_W; x++) {
      const size_t j = ((size_t)y * FRAME_W + x) << 2;
      float cr = 0.0f, cg = 0.0f, cb = 0.0f;
      for (int gi = 0; gi < GROUP_N; gi++) {
        bool hidden = false;
        for (int m = 0; m < G_MASK_N[gi]; m++) {
          const int mi = G_MASK_AT[gi] + m;
          if (!maskOn(layerBuf[MASK_LAYER[mi]] + j, MASK_PXART[mi] != 0, MASK_INVERT[mi] != 0)) {
            hidden = true;
            break;
          }
        }
        if (hidden) continue;
        const uint8_t* p = layerBuf[G_LAYER[gi]] + j;
        const float a = (p[3] / 255.0f) * G_OPACITY[gi];
        if (a <= 0.0f) continue;
        const float sr = p[0], sg = p[1], sb = p[2], inv = 1.0f - a;
        switch (G_BLEND[gi]) {
          case 1: cr += sr * a; cg += sg * a; cb += sb * a; break;
          case 2:
            cr = cr * inv + (cr * sr / 255.0f) * a;
            cg = cg * inv + (cg * sg / 255.0f) * a;
            cb = cb * inv + (cb * sb / 255.0f) * a;
            break;
          case 3:
            cr = cr * inv + (255.0f - (255.0f - cr) * (255.0f - sr) / 255.0f) * a;
            cg = cg * inv + (255.0f - (255.0f - cg) * (255.0f - sg) / 255.0f) * a;
            cb = cb * inv + (255.0f - (255.0f - cb) * (255.0f - sb) / 255.0f) * a;
            break;
          default:
            cr = cr * inv + sr * a;
            cg = cg * inv + sg * a;
            cb = cb * inv + sb * a;
            break;
        }
      }
      int ir = (int)(cr + 0.5f); if (ir > 255) ir = 255;
      int ig = (int)(cg + 0.5f); if (ig > 255) ig = 255;
      int ib = (int)(cb + 0.5f); if (ib > 255) ib = 255;
      PFCanvas::setPixel(x, y, (uint8_t)ir, (uint8_t)ig, (uint8_t)ib);
    }
  }
  PFCanvas::present();
}

} // namespace LabStack_HANYEONGHOE

// ── Made with Patternflow Community · https://patternflow.work/community ──
// Shared under CC-BY-SA-4.0. Attribution is part of this licence —
// please keep this notice and the author credit above when you reuse,
// remix, or redistribute this pattern. Do not delete it.
