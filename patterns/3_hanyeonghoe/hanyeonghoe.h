// SPDX-License-Identifier: CC-BY-SA-4.0
// Pattern: HANYEONGHOE — Pattern Lab layer-stack composition (3 layers)
//
// SCAFFOLD (deterministic, generated by Pattern Lab — do not hand-edit):
// buffers, shared-knob accumulation, ramp LUTs, pixel art, masks, blending
// and compositing are finished code. ONLY the "namespace L<i>" blocks between
// the >>> markers are translated from each layer's JavaScript; stubs compile
// to a black layer until replaced.
//
// Layers (bottom → top):
//   L0. Pixel 1 (pixel, normal, 100%)
//   L1. Cloud (code, normal, 100%)
//   L2. flower (code, normal, 100%)
#pragma once

// ===== Patternflow pattern =====
// Title:    HANYEONGHOE
// Author:   @engmung
// Date:     2026-09-19
// SPDX-License-Identifier: CC-BY-SA-4.0
// ===============================
#include <Arduino.h>
#include "config.h"
#include "src/core_display.h"
#include "src/core_encoders.h"
#include "src/core_canvas.h"
#include "src/core_mem.h"
#include "src/core_math.h"
#include "src/core_color.h"
#include "src/core_noise.h"
#include "src/core_params.h"

namespace LabStack_HANYEONGHOE {

const char* NAME = "HANYEONGHOE";
const char* const KNOB_LABELS[4] = {"Bloom", "CloudSize", "Wind", "Unused"};
// Knobs run through PFParams: the MQTT absolute bus (Director / Show
// manager, 0..1000) can pin any of them deterministically.
constexpr bool ABSOLUTE_READY = true;

constexpr int FRAME_W = 64;
constexpr int FRAME_H = 128;
constexpr int PIX_N = FRAME_W * FRAME_H;
constexpr int LAYER_N = 3;

// ── Shared knobs: encoder detents become values HERE, once, for every layer ──
static const float KNOB_MIN[4]  = {2.0f, 0.8f, 0.3f, 0.0f};
static const float KNOB_MAX[4]  = {8.5f, 2.6f, 5.5f, 1.0f};
static const float KNOB_STEP[4] = {0.13542f, 0.0375f, 0.10833f, 0.02083f}; // value per detent — two turns cross the range
static float knobVal[4]  = {5.25f, 1.7f, 2.9f, 0.494f};
static float knobNorm[4] = {0.5f, 0.5f, 0.5f, 0.494f};

// ── Layer buffers (RGBA8, PSRAM-first, allocated once in setup) ──
static uint8_t* layerBuf[LAYER_N] = {nullptr, nullptr, nullptr};
// exhibit: alpha255[i] = i / 255.0f, the composite's per-layer alpha. Each '/' is a
// __divsf3 call on the S3 (no hardware divide): three per pixel, 24,576 per frame. The
// table holds the very same quotients, so the picture is bit-identical. 1 KB -> PFMem.
static float* alpha255 = nullptr;

// ── Composite plan (bottom → top; blend: 0 normal, 1 add, 2 multiply, 3 screen) ──
constexpr int GROUP_N = 3;
static const uint8_t G_LAYER[3]   = {0, 1, 2};
static const float   G_OPACITY[3] = {1.0f, 1.0f, 1.0f};
static const uint8_t G_BLEND[3]   = {0, 0, 0};
static const uint8_t G_MASK_AT[3] = {0, 0, 0};
static const uint8_t G_MASK_N[3]  = {0, 0, 0};
static const uint8_t MASK_LAYER[1]  = {0};
static const uint8_t MASK_PXART[1]  = {0};
static const uint8_t MASK_INVERT[1] = {0};

// ── L0 "Pixel 1": pixel art, RLE {count,r,g,b,a} — decoded once in setup ──
static const uint8_t L0_RLE[7820] = {
  9,49,111,211,255,4,54,99,171,255,4,29,97,205,255,5,54,99,171,255,
  106,49,111,211,255,1,54,99,171,255,40,49,111,211,255,1,24,100,220,255,
  3,49,111,211,255,5,24,100,220,255,4,53,120,227,255,10,24,100,220,255,
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  128,0,36,30,255,1,4,36,0,255,60,0,36,30,255,3,4,36,0,255
};

// ── L1 "Cloud": ramp LUT (RGBA, alpha included — baked by Pattern Lab, copy-proof) ──
static const uint8_t L1_RAMP[256][4] = {
  {0,0,0,0},{18,18,18,53},{63,63,63,105},{114,114,114,158},{169,169,169,211},{218,218,218,255},{213,213,213,255},{208,208,208,255},
  {203,203,203,255},{199,199,199,255},{194,194,194,255},{194,194,194,255},{194,194,194,255},{194,194,194,255},{194,194,194,255},{194,194,194,255},
  {194,194,194,255},{194,194,194,255},{194,194,194,255},{194,194,194,255},{194,194,194,255},{194,194,194,255},{194,194,194,255},{194,194,194,255},
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  {252,252,252,255},{252,252,252,255},{253,253,253,255},{253,253,253,255},{254,254,254,255},{254,254,254,255},{255,255,255,255},{255,255,255,255}
};
static inline void L1_setValue(int x, int y, float v) {
  if ((unsigned)x >= (unsigned)FRAME_W || (unsigned)y >= (unsigned)FRAME_H) return;
  if (!(v > 0.0f)) v = 0.0f; else if (v > 1.0f) v = 1.0f;
  const uint8_t* c = L1_RAMP[(int)(v * 255.0f + 0.5f)];
  uint8_t* p = layerBuf[1] + (((size_t)y * FRAME_W + x) << 2);
  p[0] = c[0]; p[1] = c[1]; p[2] = c[2]; p[3] = c[3];
}
static inline void L1_setPixel(int x, int y, uint8_t r, uint8_t g, uint8_t b) {
  if ((unsigned)x >= (unsigned)FRAME_W || (unsigned)y >= (unsigned)FRAME_H) return;
  uint8_t* p = layerBuf[1] + (((size_t)y * FRAME_W + x) << 2);
  p[0] = r; p[1] = g; p[2] = b; p[3] = 255;
}

// ── L2 "flower": ramp LUT (RGBA, alpha included — baked by Pattern Lab, copy-proof) ──
static const uint8_t L2_RAMP[256][4] = {
  {0,0,0,0},{0,50,6,53},{0,99,12,105},{0,149,17,158},{0,198,23,211},{0,239,28,255},{0,236,29,255},{0,232,30,255},
  {0,228,30,255},{0,225,31,255},{0,221,32,255},{0,217,32,255},{0,214,33,255},{0,210,34,255},{0,206,35,255},{0,203,35,255},
  {0,199,36,255},{0,195,37,255},{0,192,37,255},{0,188,38,255},{0,184,39,255},{0,181,40,255},{0,177,40,255},{0,173,41,255},
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  {255,236,0,255},{255,236,0,255},{255,235,0,255},{255,235,0,255},{255,235,0,255},{255,234,0,255},{255,234,0,255},{255,234,0,255}
};
static inline void L2_setValue(int x, int y, float v) {
  if ((unsigned)x >= (unsigned)FRAME_W || (unsigned)y >= (unsigned)FRAME_H) return;
  if (!(v > 0.0f)) v = 0.0f; else if (v > 1.0f) v = 1.0f;
  const uint8_t* c = L2_RAMP[(int)(v * 255.0f + 0.5f)];
  uint8_t* p = layerBuf[2] + (((size_t)y * FRAME_W + x) << 2);
  p[0] = c[0]; p[1] = c[1]; p[2] = c[2]; p[3] = c[3];
}
static inline void L2_setPixel(int x, int y, uint8_t r, uint8_t g, uint8_t b) {
  if ((unsigned)x >= (unsigned)FRAME_W || (unsigned)y >= (unsigned)FRAME_H) return;
  uint8_t* p = layerBuf[2] + (((size_t)y * FRAME_W + x) << 2);
  p[0] = r; p[1] = g; p[2] = b; p[3] = 255;
}

// >>> LAYER 1 TRANSLATION BEGIN <<<
namespace L1 { // "Cloud" — up to six cloud heads of 16 soft dabs each, drifting right on the wind
  // knobVal[0] Bloom = how many heads (a head shows while its threshold <= Bloom),
  // knobVal[1] CloudSize = scale, knobVal[2] Wind = drift speed. K1 press = gust.
  constexpr int L1_CLOUD_N = 6;
  constexpr int L1_DAB_N = 16;
  // JS maxCloudY = min(h, floor(h * 0.52)) = 66 for h = 128: the only rows this layer paints.
  constexpr int L1_ROWS = (FRAME_H * 52) / 100;
  constexpr int L1_BUF_N = FRAME_W * L1_ROWS;
  constexpr float L1_TWENTY_PI = 62.8318531f; // 20π: a dab phase feeds cos(p), sin(1.3p), sin(1.4p) only
  constexpr float L1_SPAN = 2.0f;             // the wrap span (-0.5 .. 1.5), also wind's exact period
  constexpr float L1_MIN_X = -0.5f;
  constexpr float L1_JITTER = 1.0f + (-1.671f) * 0.3f; // 0.4987, a constant in the JS

  struct Cloud { float x, y, threshold, baseTone, alphaRate; };
  struct Dab { float ox, oy, rx, ry, phase, pulseFreq; };

  // parentClouds, as written in the JS: x, y, threshold, baseTone, alphaRate.
  static const Cloud CLOUDS[L1_CLOUD_N] = {
    { -0.15f, 0.17f, 1.0f, 0.95f, 0.62f }, // thick, bright white
    {  0.15f, 0.24f, 2.0f, 0.72f, 0.44f }, // thin and soft
    {  0.45f, 0.16f, 3.0f, 0.86f, 0.55f }, // mid tone
    {  0.75f, 0.25f, 4.0f, 0.92f, 0.60f }, // big and full
    {  1.05f, 0.18f, 5.0f, 0.68f, 0.42f }, // faint, see-through
    {  1.35f, 0.23f, 6.0f, 0.82f, 0.50f }  // natural mid
  };

  // The JS builds the dabs in setup() from hash(n) = fract(sin(n * 127.1) * 43758.5453)
  // in double precision. In float32 that hash lands somewhere else entirely (the sine
  // of ~27000 rad), so the finished table is baked here instead: generated by running
  // the layer's own setup() in node, none of it typed by hand. 2.3 KB of flash.
  // ox, oy, rx, ry, phase, pulseFreq — 16 per cloud, from the JS setup() run in double precision
  static const Dab DABS[L1_CLOUD_N * L1_DAB_N] = {
    // cloud 0 (seed 15.2)
    { 0.0401866361f, 0.0234832615f, 0.116397604f, 0.0310698748f, 4.59136105f, 1.27333581f },
    { -0.142920390f, -0.00315683172f, 0.0841749161f, 0.0354568213f, 1.18844748f, 1.13236654f },
    { -0.0374513082f, 0.00686207507f, 0.120409891f, 0.0300508682f, 0.273599505f, 1.02053654f },
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    { -0.0461134464f, 0.00237060105f, 0.116786681f, 0.0405296981f, 1.74248207f, 1.05209279f },
    // cloud 1 (seed 48.7)
    { -0.0103288842f, -0.0207564961f, 0.0996157974f, 0.0343135670f, 3.77722669f, 1.17072070f },
    { -0.0646307692f, -0.0429249331f, 0.126869917f, 0.0381153300f, 2.25676703f, 0.866457343f },
    { 0.172232941f, -0.0191691183f, 0.111231498f, 0.0281439275f, 1.42374063f, 1.29783666f },
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    { 0.0695530102f, -0.00252653053f, 0.109042645f, 0.0359782949f, 2.83355594f, 1.16115928f },
    // cloud 2 (seed 82.1)
    { 0.143276438f, -0.0259406008f, 0.0871319249f, 0.0274408404f, 5.84374428f, 1.26245189f },
    { -0.0996734798f, -0.0233307052f, 0.113314100f, 0.0353976898f, 2.34528399f, 1.29831004f },
    { -0.153302908f, 0.0451187082f, 0.0939269513f, 0.0327404886f, 0.781885743f, 0.972771466f },
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    { -0.00648701284f, 0.0179541204f, 0.119809635f, 0.0301904026f, 0.549818575f, 1.15144467f },
    // cloud 3 (seed 33.9)
    { 0.0648494512f, -0.0298546609f, 0.103828363f, 0.0292959623f, 1.00023174f, 1.23904514f },
    { -0.181724802f, 0.0329342373f, 0.106172092f, 0.0351574868f, 5.90388489f, 0.772015393f },
    { -0.0892039165f, 0.0364899710f, 0.111105479f, 0.0342830457f, 0.802271724f, 1.14244831f },
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    { 0.147503555f, -0.0566380210f, 0.0886768699f, 0.0274913087f, 3.90008616f, 1.10742581f },
    // cloud 4 (seed 61.3)
    { -0.0152044678f, -0.000264884089f, 0.142319337f, 0.0374282338f, 2.84917021f, 0.919273496f },
    { 0.175376758f, 0.0110027269f, 0.0797477365f, 0.0280830003f, 1.90257239f, 1.17572761f },
    { -0.123865627f, 0.0553819947f, 0.0858292729f, 0.0260124449f, 4.28520727f, 1.20252049f },
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    { 0.150875032f, -0.0284551848f, 0.111079596f, 0.0255309567f, 1.87051475f, 1.25716496f },
    // cloud 5 (seed 94.8)
    { -0.144369602f, 0.0379400738f, 0.0872469172f, 0.0250927936f, 5.53959799f, 0.911135375f },
    { -0.0202165898f, -0.00836894289f, 0.143619865f, 0.0325530134f, 2.96325016f, 1.24394548f },
    { -0.0942429528f, -0.0747296363f, 0.0995836481f, 0.0262506548f, 1.74399340f, 0.736449003f },
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    { 0.0252779089f, 0.0680997521f, 0.0900718570f, 0.0330038555f, 6.15877867f, 0.966602206f },
  };

  // Per-dab phase accumulators (the JS dab.p, starting at dab.phase). 384 B.
  static float p[L1_CLOUD_N * L1_DAB_N];
  static float wind = 0.0f;
  static float gustTarget = 0.0f; // K1 press gust target; 0 on the idle return
  static float gust = 0.0f;       // gust strength 0..1; 0 on the idle return
  static float stretch = 1.0f;    // 1 + 0.3 gust, recomputed every frame
  static float count = 5.25f;
  static float scale = 1.7f;

  // One frame's scratch over the 66 painted rows.
  // exhibit: 16.9 KB + 2 x 4.2 KB, so PFMem (PSRAM-first, once in setup).
  static float* trans = nullptr;     // remaining transparency: product of (1 - dab alpha)
  static uint8_t* toneIdx = nullptr; // the JS toneBuf (brightest baseTone that touched the
                                     // pixel) as the index of that cloud: same values, 1/4 the RAM
  static uint8_t* counts = nullptr;  // dabs that touched the pixel, capped at 8

  static inline int iceil(float x) { return -PFMath::ifloor(-x); }

  void setup() {
    PFMath::buildSinLUT();
    if (!trans) trans = PFMem::allocFloats(L1_BUF_N);
    if (!toneIdx) toneIdx = (uint8_t*)PFMem::alloc(L1_BUF_N);
    if (!counts) counts = (uint8_t*)PFMem::alloc(L1_BUF_N);
    for (int i = 0; i < L1_CLOUD_N * L1_DAB_N; i++) p[i] = DABS[i].phase;
    wind = 0.0f;
    gustTarget = 0.0f;
    gust = 0.0f;
    stretch = 1.0f;
  }

  void update(float dt, const InputFrame& input) {
    // K1 press: gust. The flower layer runs the same formula on the same input, so the
    // two always hold the same value. gustTarget jumps to 1 and falls 0.45/s to 0 (it
    // stops there - nothing accumulates); gust follows it with a ~0.14 s time constant.
    // A press during a gust only puts gustTarget back to 1.
    if (input.btnPressed[0]) gustTarget = 1.0f;
    gustTarget -= dt * 0.45f;
    if (gustTarget < 0.0f) gustTarget = 0.0f;
    float follow = dt * 7.0f;
    if (follow > 1.0f) follow = 1.0f;
    gust += (gustTarget - gust) * follow;
    if (gustTarget == 0.0f && gust < 0.001f) gust = 0.0f;

    // The gust adds to the drift speed rather than multiplying it.
    wind += dt * (knobVal[2] * 0.11f + gust * 0.4f);
    // wind is only used inside the 2.0 span: 2.0 is exactly one lap.
    if (wind >= L1_SPAN) wind -= L1_SPAN;

    // A phase per dab (pulseFreq differs per dab, so one shared clock would not wrap);
    // the gust speeds the billowing up too.
    const float rate = dt * 1.1f;
    const float gustMul = 1.0f + 2.0f * gust;
    for (int i = 0; i < L1_CLOUD_N * L1_DAB_N; i++) {
      p[i] += rate * DABS[i].pulseFreq * gustMul;
      if (p[i] >= L1_TWENTY_PI) p[i] -= L1_TWENTY_PI;
    }
    count = knobVal[0];
    scale = knobVal[1];
    stretch = 1.0f + 0.3f * gust; // the gust stretches the clouds sideways (1 .. 1.3)
  }

  void draw() {
    if (!trans || !toneIdx || !counts) return;
    // The JS resets trans = 1, tone = 0 and counts = 0 every frame. Only counts is
    // cleared here: the first dab to touch a pixel writes trans = 1 - alpha and its
    // cloud as the tone, exactly what 1 * (1 - alpha) and max(0, baseTone) give.
    memset(counts, 0, L1_BUF_N);

    const float fW = (float)FRAME_W;
    const float fH = (float)FRAME_H;
    const float invW = 1.0f / (float)(FRAME_W - 1);
    const float invH = 1.0f / (float)(FRAME_H - 1);
    const float sqrtScale = sqrtf(scale);
    const float sx = L1_JITTER * scale * stretch;
    const float sy = L1_JITTER * scale;
    int rowLo = L1_ROWS, rowHi = -1; // the rows any dab touched this frame

    for (int c = 0; c < L1_CLOUD_N; c++) {
      const Cloud& cloud = CLOUDS[c];
      if (cloud.threshold > count) continue;

      // JS: ((x + wind - minX) % span), + span if negative, + minX. The dividend stays
      // in 0.35 .. 3.85.
      float cx = PFMath::jsMod(cloud.x + wind - L1_MIN_X, L1_SPAN);
      if (cx < 0.0f) cx += L1_SPAN;
      cx += L1_MIN_X;

      const float alphaRate = cloud.alphaRate;
      const float baseTone = cloud.baseTone;
      const Dab* dabs = DABS + c * L1_DAB_N;
      const float* ph = p + c * L1_DAB_N;

      for (int d = 0; d < L1_DAB_N; d++) {
        const Dab& dab = dabs[d];
        const float pp = ph[d];
        const float driftX = PFMath::fastCos(pp) * 0.007f;
        const float driftY = PFMath::fastSin(pp * 1.3f) * 0.004f;
        const float dabPosX = cx + (dab.ox + driftX) * sx;
        const float dabPosY = cloud.y + (dab.oy + driftY) * sy;

        const float sizePulse = 1.0f + PFMath::fastSin(pp * 1.4f) * 0.10f;
        const float rX = dab.rx * sqrtScale * sizePulse * stretch;
        const float rY = dab.ry * sqrtScale * sizePulse;

        const int minPxX = PFMath::ifloor((dabPosX - rX) * fW);
        const int maxPxX = iceil((dabPosX + rX) * fW);
        const int minPxY = PFMath::ifloor((dabPosY - rY) * fH);
        const int maxPxY = iceil((dabPosY + rY) * fH);
        if (maxPxX < 0 || minPxX >= FRAME_W || maxPxY < 0 || minPxY >= L1_ROWS) continue;

        const int x0 = minPxX < 0 ? 0 : minPxX;
        const int x1 = maxPxX > FRAME_W - 1 ? FRAME_W - 1 : maxPxX;
        const int y0 = minPxY < 0 ? 0 : minPxY;
        const int y1 = maxPxY > L1_ROWS - 1 ? L1_ROWS - 1 : maxPxY;

        const float invRxSq = 1.0f / (rX * rX);
        const float invRySq = 1.0f / (rY * rY);

        for (int py = y0; py <= y1; py++) {
          const float dy = (float)py * invH - dabPosY;
          const float dySqNorm = (dy * dy) * invRySq;
          if (dySqNorm >= 1.0f) continue;
          if (py < rowLo) rowLo = py;
          if (py > rowHi) rowHi = py;
          const int rowOffset = py * FRAME_W;
          for (int px = x0; px <= x1; px++) {
            const float dx = (float)px * invW - dabPosX;
            const float distNorm = (dx * dx) * invRxSq + dySqNorm;
            if (distNorm < 1.0f) {
              const int idx = rowOffset + px;
              const float alpha = (1.0f - distNorm) * alphaRate;
              const uint8_t n = counts[idx];
              if (n == 0) {
                trans[idx] = 1.0f - alpha;
                toneIdx[idx] = (uint8_t)c;
                counts[idx] = 1;
              } else {
                trans[idx] *= (1.0f - alpha);
                if (baseTone > CLOUDS[toneIdx[idx]].baseTone) toneIdx[idx] = (uint8_t)c;
                if (n < 8) counts[idx] = (uint8_t)(n + 1);
              }
            }
          }
        }
      }
    }

    // Final pass. The JS writes 0.0 to every untouched pixel and to the rows below the
    // clouds. The scaffold has already cleared this layer to zero bytes, which is what
    // 0.0 paints while ramp(0.0) is transparent black (it is, in this ramp), so only the
    // touched pixels are written. Should the ramp ever change, paint 0.0 as the JS does.
    if (L1_RAMP[0][0] | L1_RAMP[0][1] | L1_RAMP[0][2] | L1_RAMP[0][3])
      for (int y = 0; y < FRAME_H; y++)
        for (int x = 0; x < FRAME_W; x++) L1_setValue(x, y, 0.0f);
    for (int py = rowLo; py <= rowHi; py++) {
      const float ny = (float)py * invH;
      // The clouds fade out over ny 0.40 .. 0.52 (1 / 0.12 = 8.33).
      float falloff = 1.0f;
      if (ny > 0.40f) {
        falloff = 1.0f - (ny - 0.40f) * 8.33f;
        if (falloff < 0.0f) falloff = 0.0f;
      }
      const int rowOffset = py * FRAME_W;
      for (int px = 0; px < FRAME_W; px++) {
        const int idx = rowOffset + px;
        const uint8_t cNum = counts[idx];
        if (cNum == 0) continue;
        const float densityVal = 1.0f - trans[idx];
        const float layerSheen = (float)cNum * 0.025f;
        L1_setValue(px, py, (densityVal * CLOUDS[toneIdx[idx]].baseTone + layerSheen) * falloff);
      }
    }
  }
}
// >>> LAYER 1 TRANSLATION END <<<

// >>> LAYER 2 TRANSLATION BEGIN <<<
namespace L2 { // "flower" — rapeseed heads, small purple flowers and grass swaying in the wind
  // knobVal[0] Bloom = flower size (a small bud 0.4 .. a full bloom 1.6; the stems grow
  // with it and lift the heads), knobVal[1] CloudSize = sway width, knobVal[2] Wind =
  // sway speed. K1 press = gust: everything leans right and sways faster and wider.
  constexpr int L2_FLOWER_N = 14;
  constexpr int L2_PURPLE_N = 13;
  constexpr int L2_GRASS_N = 20;
  constexpr float L2_TWENTY_PI = 62.8318531f; // 20π: windTime feeds sin(t), sin(1.2t), sin(1.3t) only

  struct Flower { float rx, fx, fy, s; bool isMain; };
  struct Purple { float rx, bx, by; };
  struct Blade { float x0, y0, x1, y1; };

  static const Flower FLOWERS[L2_FLOWER_N] = {
    { 5.0f,  5.0f,  88.0f,  1.1f, false },
    { 7.0f,  6.0f,  78.0f,  1.0f, false },
    { 9.0f,  9.0f,  80.0f,  1.2f, true  },
    { 11.0f, 11.0f, 91.0f,  1.1f, false },
    { 15.0f, 15.0f, 76.0f,  1.3f, true  },
    { 17.0f, 17.0f, 86.0f,  1.1f, false },
    { 17.0f, 16.0f, 97.0f,  1.1f, false },
    { 20.0f, 20.0f, 89.0f,  1.1f, false },
    { 22.0f, 22.0f, 68.0f,  1.6f, true  },
    { 27.0f, 27.0f, 100.0f, 1.2f, false },
    { 28.0f, 28.0f, 76.0f,  1.4f, true  },
    { 32.0f, 33.0f, 80.0f,  1.3f, true  },
    { 42.0f, 43.0f, 116.0f, 1.2f, false },
    { 55.0f, 56.0f, 120.0f, 1.2f, false }
  };

  static const Purple PURPLES[L2_PURPLE_N] = {
    { 14.0f, 14.0f, 106.0f }, { 16.0f, 16.0f, 104.0f }, { 22.0f, 22.0f, 103.0f },
    { 24.0f, 24.0f, 101.0f }, { 25.0f, 25.0f, 110.0f }, { 35.0f, 35.0f, 112.0f },
    { 37.0f, 37.0f, 104.0f }, { 38.0f, 38.0f, 113.0f }, { 43.0f, 43.0f, 105.0f },
    { 45.0f, 45.0f, 99.0f  }, { 49.0f, 49.0f, 108.0f }, { 51.0f, 51.0f, 103.0f },
    { 59.0f, 59.0f, 114.0f }
  };

  static const Blade BLADES[L2_GRASS_N] = {
    { 2.0f, 127.0f, 8.0f, 108.0f },   { 4.0f, 127.0f, 3.0f, 101.0f },
    { 6.0f, 127.0f, 12.0f, 105.0f },  { 8.0f, 127.0f, 5.0f, 111.0f },
    { 12.0f, 127.0f, 16.0f, 103.0f }, { 14.0f, 127.0f, 9.0f, 107.0f },
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    { 58.0f, 127.0f, 62.0f, 113.0f }, { 60.0f, 127.0f, 54.0f, 109.0f }
  };

  // Rapeseed petals: dx, dy, rx, ry, all x s.
  static const float PETALS[5][4] = {
    {  0.0f, -1.8f, 1.1f, 1.4f },
    { -1.4f, -1.4f, 1.0f, 1.3f },
    {  1.4f, -1.4f, 1.0f, 1.3f },
    { -2.4f, -0.4f, 1.1f, 1.1f },
    {  2.4f, -0.4f, 1.1f, 1.1f }
  };

  static float windTime = 0.0f;
  static float gustTarget = 0.0f; // K1 press gust target; 0 on the idle return
  static float gust = 0.0f;       // gust strength 0..1; 0 on the idle return
  static float swayAmp = 1.0f;    // 1 + 1.5 gust, recomputed every frame
  static float lean = 0.0f;       // 5 gust px to the right, recomputed every frame
  static float bloom = 1.0f;
  static float sway = 1.7f;

  static inline int iceil(float x) { return -PFMath::ifloor(-x); }

  static inline void plot(float x, float y, float v) {
    L2_setValue(PFMath::ifloor(x), PFMath::ifloor(y), v); // bounds-checked there
  }

  // Samples the segment every half pixel. For the radii used here (0.7, 0.5) the brush
  // is the single centre pixel, but the loop is kept general, as in the JS.
  static void drawBrushLine(float x0, float y0, float x1, float y1, float radius, float val) {
    const float ddx = x1 - x0;
    const float ddy = y1 - y0;
    const float dist = sqrtf(ddx * ddx + ddy * ddy);
    int steps = PFMath::ifloor(dist * 2.0f);
    if (steps < 1) steps = 1;
    const int r = PFMath::ifloor(radius);
    const float radSq = radius * radius;
    const float invSteps = 1.0f / (float)steps;
    if (r == 0) {
      // A one-pixel brush (every call here): samples 0.5 px apart mostly land on the
      // pixel before them, and repainting a pixel with the same value changes nothing.
      int lastX = INT32_MIN, lastY = INT32_MIN;
      for (int i = 0; i <= steps; i++) {
        const float frac = (float)i * invSteps;
        const int px = PFMath::ifloor(x0 + ddx * frac);
        const int py = PFMath::ifloor(y0 + ddy * frac);
        if (px == lastX && py == lastY) continue;
        lastX = px; lastY = py;
        L2_setValue(px, py, val);
      }
      return;
    }
    for (int i = 0; i <= steps; i++) {
      const float frac = (float)i * invSteps;
      const float cx = x0 + ddx * frac;
      const float cy = y0 + ddy * frac;
      for (int dy = -r; dy <= r; dy++)
        for (int dx = -r; dx <= r; dx++)
          if ((float)(dx * dx + dy * dy) <= radSq) plot(cx + (float)dx, cy + (float)dy, val);
    }
  }

  static void drawDab(float cx, float cy, float rx, float ry, float val) {
    const int startX = PFMath::ifloor(cx - rx);
    const int endX = iceil(cx + rx);
    const int startY = PFMath::ifloor(cy - ry);
    const int endY = iceil(cy + ry);
    const float invRx = 1.0f / rx;
    const float invRy = 1.0f / ry;
    for (int py = startY; py <= endY; py++) {
      const float dy = ((float)py - cy) * invRy;
      const float dySq = dy * dy;
      if (dySq > 1.0f) continue; // no pixel of this row can pass
      for (int px = startX; px <= endX; px++) {
        const float dx = ((float)px - cx) * invRx;
        if (dx * dx + dySq <= 1.0f) L2_setValue(px, py, val);
      }
    }
  }

  // Crown-shaped rapeseed head.
  static void drawRapeFlowerHead(float cx, float cy, float scale, bool isMain) {
    const float s = scale * bloom;
    const float coreVal = isMain ? 0.88f : 0.65f;
    const float petalVal = isMain ? 0.98f : 0.72f;
    const float calyxVal = 0.32f;
    drawDab(cx, cy + 1.2f * s, 1.6f * s, 0.8f * s, calyxVal);
    drawDab(cx, cy + 0.3f * s, 1.8f * s, 1.2f * s, coreVal);
    for (int i = 0; i < 5; i++)
      drawDab(cx + PETALS[i][0] * s, cy + PETALS[i][1] * s, PETALS[i][2] * s, PETALS[i][3] * s, petalVal);
  }

  // Small purple flower, 3-4 px wide.
  static void drawCompactPurpleFlower(float cx, float cy, float val) {
    // Below the bud size (0.6) the pixels would vanish, so it stops there.
    float s = bloom * 0.95f;
    if (s < 0.6f) s = 0.6f;
    drawDab(cx, cy, 1.3f * s, 0.8f * s, val);                                  // core
    drawDab(cx - 1.3f * s, cy - 0.2f * s, 0.8f * s, 0.5f * s, val + 0.05f);  // left wing
    drawDab(cx + 1.3f * s, cy - 0.2f * s, 0.8f * s, 0.5f * s, val + 0.05f);  // right wing
    drawDab(cx, cy - 0.8f * s, 0.6f * s, 0.6f * s, val + 0.03f);             // top
  }

  void setup() {
    windTime = 0.0f;
    gustTarget = 0.0f;
    gust = 0.0f;
    swayAmp = 1.0f;
    lean = 0.0f;
  }

  void update(float dt, const InputFrame& input) {
    // K1 press: gust - the same formula as the cloud layer (see L1::update).
    if (input.btnPressed[0]) gustTarget = 1.0f;
    gustTarget -= dt * 0.45f;
    if (gustTarget < 0.0f) gustTarget = 0.0f;
    float follow = dt * 7.0f;
    if (follow > 1.0f) follow = 1.0f;
    gust += (gustTarget - gust) * follow;
    if (gustTarget == 0.0f && gust < 0.001f) gust = 0.0f;

    // The gust adds to the sway speed rather than multiplying it: fast even at K3's
    // minimum, not frantic at its maximum.
    windTime += dt * (knobVal[2] * 2.0f + gust * 6.0f);
    // windTime only feeds sin(t), sin(1.2t), sin(1.3t): 20π is exactly one lap.
    if (windTime >= L2_TWENTY_PI) windTime -= L2_TWENTY_PI;

    float tNorm = (knobVal[0] - 2.0f) / 6.5f;
    if (tNorm < 0.0f) tNorm = 0.0f; else if (tNorm > 1.0f) tNorm = 1.0f;
    // Flower size 0.4 (small bud) .. 1.6 (full bloom), 1.0 in the middle.
    bloom = 0.4f + tNorm * 1.2f;

    sway = knobVal[1];

    // The gust's shape, once per frame: sway width x(1 + 1.5 gust), lean right in px.
    swayAmp = 1.0f + 1.5f * gust;
    lean = gust * 5.0f;
  }

  void draw() {
    // The JS clears the layer to 0.0 first. The scaffold has already cleared it to zero
    // bytes, which is what 0.0 paints while ramp(0.0) is transparent black (it is, in
    // this ramp). Should the ramp ever change, clear to 0.0 as the JS does.
    if (L2_RAMP[0][0] | L2_RAMP[0][1] | L2_RAMP[0][2] | L2_RAMP[0][3])
      for (int y = 0; y < FRAME_H; y++)
        for (int x = 0; x < FRAME_W; x++) L2_setValue(x, y, 0.0f);

    const float t = windTime;
    const float swayK = 1.0f + sway * 0.4f;
    // The stems grow as the flowers bloom and lift the heads: 0 in the middle, -4 px
    // at the bud end, +4 px at full bloom (half that for the purple flowers).
    const float lift = (bloom - 1.0f) * 7.0f;
    const float liftBud = (bloom - 1.0f) * 3.5f;

    // Each sway is used twice (stem, then head): computed once per frame. ~50 sinf.
    float swayF[L2_FLOWER_N];
    float swayP[L2_PURPLE_N];
    for (int i = 0; i < L2_FLOWER_N; i++)
      swayF[i] = sinf(t + (float)i * 1.5f) * 1.1f * swayK * swayAmp + lean;
    for (int k = 0; k < L2_PURPLE_N; k++)
      swayP[k] = sinf(t * 1.2f + (float)k * 1.8f) * 0.9f * swayK * swayAmp + lean * 0.8f;

    // 1. Stems, from the ground (y 127).
    for (int i = 0; i < L2_FLOWER_N; i++) {
      const Flower& fl = FLOWERS[i];
      const float stemVal = 0.22f + (float)(i % 3) * 0.03f;
      drawBrushLine(fl.rx, 127.0f, fl.fx + swayF[i], fl.fy - lift + 1.5f, 0.7f, stemVal);
    }
    for (int k = 0; k < L2_PURPLE_N; k++) {
      const Purple& pf = PURPLES[k];
      drawBrushLine(pf.rx, 127.0f, pf.bx + swayP[k], pf.by - liftBud + 1.2f, 0.5f, 0.23f);
    }

    // 2. Grass blades.
    for (int j = 0; j < L2_GRASS_N; j++) {
      const Blade& gb = BLADES[j];
      const float swayGrass = sinf(t * 1.3f + (float)j) * 0.6f * swayAmp + lean * 0.6f;
      const float bladeVal = 0.06f + (float)((j * 7) % 11) * 0.01f;
      drawBrushLine(gb.x0, gb.y0, gb.x1 + swayGrass, gb.y1, 0.7f, bladeVal);
    }

    // 3. Purple flower heads.
    for (int k = 0; k < L2_PURPLE_N; k++) {
      const Purple& pf = PURPLES[k];
      const float baseTone = 0.38f + (float)(k % 4) * 0.03f;
      drawCompactPurpleFlower(pf.bx + swayP[k], pf.by - liftBud, baseTone);
    }

    // 4. Yellow rapeseed heads, on top.
    for (int i = 0; i < L2_FLOWER_N; i++) {
      const Flower& fl = FLOWERS[i];
      drawRapeFlowerHead(fl.fx + swayF[i], fl.fy - lift, fl.s, fl.isMain);
    }
  }
}
// >>> LAYER 2 TRANSLATION END <<<

// ── Deterministic pipeline (do not edit) ──
static void rleDecode(const uint8_t* rle, size_t len, uint8_t* out) {
  size_t o = 0;
  const size_t cap = (size_t)PIX_N * 4;
  for (size_t i = 0; i + 4 < len && o < cap; i += 5) {
    for (int k = 0; k < rle[i] && o < cap; k++) {
      out[o++] = rle[i + 1]; out[o++] = rle[i + 2]; out[o++] = rle[i + 3]; out[o++] = rle[i + 4];
    }
  }
}

// Binary mask test — identical to the Pattern Lab preview: pixel art is "on"
// where something was drawn (alpha >= 0.5); code layers where ramp-colored
// luminance x alpha crosses 0.5.
static inline bool maskOn(const uint8_t* p, bool pixelArt, bool invert) {
  bool on;
  if (pixelArt) on = p[3] >= 128;
  else on = (0.2126f * p[0] + 0.7152f * p[1] + 0.0722f * p[2]) * (p[3] / 255.0f) >= 127.5f;
  return invert ? !on : on;
}

static void recolorBuffer(uint8_t* buf, const uint8_t lut[256][4]) {
  for (int i = 0; i < PIX_N; i++) {
    uint8_t* p = buf + (size_t)i * 4;
    if (p[3] == 0) continue;
    int lum = (int)(0.2126f * p[0] + 0.7152f * p[1] + 0.0722f * p[2] + 0.5f);
    if (lum > 255) lum = 255;
    const uint8_t* c = lut[lum];
    p[0] = c[0]; p[1] = c[1]; p[2] = c[2]; p[3] = c[3];
  }
}

void setup() {
  for (int i = 0; i < LAYER_N; i++)
    if (!layerBuf[i]) layerBuf[i] = (uint8_t*)PFMem::alloc((size_t)PIX_N * 4);
  for (int i = 0; i < LAYER_N; i++)
    if (!layerBuf[i]) return; // allocation failed → draw() degrades to blank
  if (!alpha255) alpha255 = PFMem::allocFloats(256);
  if (!alpha255) return;
  for (int i = 0; i < 256; i++) alpha255[i] = (float)i / 255.0f;
  rleDecode(L0_RLE, sizeof(L0_RLE), layerBuf[0]);
  L1::setup();
  L2::setup();
}

void update(float dt, const InputFrame& input) {
  for (int i = 0; i < 4; i++) {
    // Absolute bus (when held) > audio/weather > encoder deltas — one call,
    // same clamping the old delta loop did.
    PFParams::apply(input, i, &knobVal[i], KNOB_MIN[i], KNOB_MAX[i], KNOB_STEP[i]);
    knobNorm[i] = (knobVal[i] - KNOB_MIN[i]) / (KNOB_MAX[i] - KNOB_MIN[i]);
  }
  L1::update(dt, input);
  L2::update(dt, input);
}

void draw() {
  PFCanvas::setFrame(FRAME_W, FRAME_H);
  for (int i = 0; i < LAYER_N; i++)
    if (!layerBuf[i]) { PFCanvas::present(); return; }
  if (!alpha255) { PFCanvas::present(); return; }

  // exhibit: the cloud layer never writes below row L1::L1_ROWS (66) and PFMem zeroed
  // the buffer, so only its rows are cleared: 16.9 KB of PSRAM writes instead of 32.8.
  memset(layerBuf[1], 0, (size_t)L1::L1_ROWS * FRAME_W * 4);
  L1::draw();
  memset(layerBuf[2], 0, (size_t)PIX_N * 4);
  L2::draw();

  // Composite bottom → top over the panel's black — same math as the web preview.
  for (int y = 0; y < FRAME_H; y++) {
    for (int x = 0; x < FRAME_W; x++) {
      const size_t j = ((size_t)y * FRAME_W + x) << 2;
      float cr = 0.0f, cg = 0.0f, cb = 0.0f;
      for (int gi = 0; gi < GROUP_N; gi++) {
        bool hidden = false;
        for (int m = 0; m < G_MASK_N[gi]; m++) {
          const int mi = G_MASK_AT[gi] + m;
          if (!maskOn(layerBuf[MASK_LAYER[mi]] + j, MASK_PXART[mi] != 0, MASK_INVERT[mi] != 0)) {
            hidden = true;
            break;
          }
        }
        if (hidden) continue;
        const uint8_t* p = layerBuf[G_LAYER[gi]] + j;
        const float a = alpha255[p[3]] * G_OPACITY[gi]; // exhibit: was (p[3] / 255.0f)
        if (a <= 0.0f) continue;
        const float sr = p[0], sg = p[1], sb = p[2], inv = 1.0f - a;
        switch (G_BLEND[gi]) {
          case 1: cr += sr * a; cg += sg * a; cb += sb * a; break;
          case 2:
            cr = cr * inv + (cr * sr / 255.0f) * a;
            cg = cg * inv + (cg * sg / 255.0f) * a;
            cb = cb * inv + (cb * sb / 255.0f) * a;
            break;
          case 3:
            cr = cr * inv + (255.0f - (255.0f - cr) * (255.0f - sr) / 255.0f) * a;
            cg = cg * inv + (255.0f - (255.0f - cg) * (255.0f - sg) / 255.0f) * a;
            cb = cb * inv + (255.0f - (255.0f - cb) * (255.0f - sb) / 255.0f) * a;
            break;
          default:
            cr = cr * inv + sr * a;
            cg = cg * inv + sg * a;
            cb = cb * inv + sb * a;
            break;
        }
      }
      int ir = (int)(cr + 0.5f); if (ir > 255) ir = 255;
      int ig = (int)(cg + 0.5f); if (ig > 255) ig = 255;
      int ib = (int)(cb + 0.5f); if (ib > 255) ib = 255;
      PFCanvas::setPixel(x, y, (uint8_t)ir, (uint8_t)ig, (uint8_t)ib);
    }
  }
  PFCanvas::present();
}

} // namespace LabStack_HANYEONGHOE

// ── Made with Patternflow Community · https://patternflow.work/community ──
// Shared under CC-BY-SA-4.0. Attribution is part of this licence —
// please keep this notice and the author credit above when you reuse,
// remix, or redistribute this pattern. Do not delete it.
